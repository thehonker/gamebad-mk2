## boards/shields/gamebad_mk2/Kconfig.defconfig
```kconfig
if SHIELD_GAMEBAD_MK2
config ZMK_KEYBOARD_NAME
  default "Gamebad Mk2"
config USB_DEVICE_MANUFACTURER
  default "TheHonker"
config SPI
  default y
config GPIO_595
  default y
endif
```

## boards/shields/gamebad_mk2_dongle/Kconfig.shield
```kconfig
config SHIELD_GAMEBAD_MK2_DONGLE
  def_bool $(shields_list_contains,gamebad_mk2_dongle)
```
